## app/west.yml
```yaml
# Copyright (c) 2025 Marcin Bober
# SPDX-License-Identifier: Apache-2.0

manifest:
  self:
    path: app

  remotes:
    - name: ncs
      url-base: https://github.com/nrfconnect

  projects:
    - name: nrf
      remote: ncs
      repo-path: sdk-nrf
      revision: v3.4.0
      clone-depth: 1
      import:
        name-allowlist:
          - cmsis_6
          - hal_nordic
          - mbedtls
          - nrfxlib
          - oberon-psa-crypto
          - segger
          - trusted-firmware-m
          - zephyr
```
